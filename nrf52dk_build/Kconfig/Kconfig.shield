## nrf52dk_build/Kconfig/Kconfig.shield
```kconfig
osource "c:/Users/henry/Documents/embedded-projects/nrf52_adc/boards/shields/*/Kconfig.shield"
osource "c:/Users/henry/Documents/embedded-projects/puck-imu/boards/shields/*/Kconfig.shield"
osource "C:/ncs/v2.0.2/nrf/boards/shields/*/Kconfig.shield"
```

## nrf52dk_build/Kconfig/Kconfig.shield.defconfig
```kconfig
osource "c:/Users/henry/Documents/embedded-projects/nrf52_adc/boards/shields/*/Kconfig.defconfig"
osource "c:/Users/henry/Documents/embedded-projects/puck-imu/boards/shields/*/Kconfig.defconfig"
osource "C:/ncs/v2.0.2/nrf/boards/shields/*/Kconfig.defconfig"
```
